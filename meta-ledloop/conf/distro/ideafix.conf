## meta-ledloop/conf/distro/ideafix.conf
```bitbake
require conf/distro/include/config-file.conf
require conf/distro/include/versions.conf

# Distro settings
DISTRO = "ideafix"
DISTRO_NAME = "Ideafix (Linux OS based on Poky. Best friend of the Gaul Village of Erni embedded community)"
DISTRO_VERSION = "1.0"
DISTRO_CODENAME = "kirkstone"
MAINTAINER = "Gonzalo Matarrubia Gonzalez <g.matarrubia@gmail.com>"
hostname:pn-base-files = "ledloop"

# SDK configs
SDK_VENDOR = "-pokysdk"
SDK_VERSION = "${@d.getVar('DISTRO_VERSION').replace('snapshot-${METADATA_REVISION}', 'snapshot')}"
SDK_VERSION[vardepvalue] = "${SDK_VERSION}"

LINUX_KERNEL_TYPE = "preempt-rt"

# Distro features
DISTRO_FEATURES:remove = "sysvinit x11"
DISTRO_FEATURES:append = " usbhost pam systemd wifi"
DISTRO_FEATURES_BACKFILL_CONSIDERED = ""

WKS_FILE = "ledloop-rpi.wks"

# Init manager configs
INIT_MANAGER = "systemd"
VIRTUAL-RUNTIME:init_manager = "systemd"
VIRTUAL-RUNTIME:initscripts = ""

# Base packages
CORE_IMAGE_EXTRA_INSTALL += " \
    linux-firmware-bcm43430 \
    bridge-utils \
    hostapd \
    iptables \
    avahi-daemon \
    kernel-modules \
    openssh openssh-keygen openssh-sftp-server \
    ntp ntp-tickadj \
    packagegroup-core-boot \
    procps \
    tzdata \
    canutils \
    nmap \
    usbutils \
    checksec \
    nikto \
    crda \
    iw \
    wpa-supplicant \
    xdg-user-dirs \
    htop \
    python3 \
    python3-pip \
    nano \
    nginx \
    fcgiwrap \
    ledloop \
    ews-ledloop \
    comm-ledloop \
"

# Miscelanious Configs
IMAGE_LINGUAS = "en-US"
BBMASK = "meta-networking/recipes-kernel/wireguard"

PACKAGECONFIG:pn-sascha-samples = "d2d"
```

## meta-ledloop/wic/ledloop-rpi.wks
```
# short-description: Create Raspberry Pi SD card image
# long-description: Creates a partitioned SD card image for use with
# Raspberry Pi. Boot files are located in the first vfat partition.

part /boot     --source bootimg-partition --ondisk mmcblk0 --fstype=vfat --label boot --align 4096 --active --size 20
part /settings --source rootfs --change-directory=settings --ondisk mmcblk0 --fstype=vfat --label settings --align 4096 --size 5M
part /         --source rootfs --exclude-path=boot/ --exclude-path=settings/ --ondisk mmcblk0 --fstype=ext4 --label root --align 4096

bootloader --ptable msdos
```
